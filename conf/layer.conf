## conf/layer.conf
```bitbake
# We have a conf and classes directory, add to BBPATH
BBPATH .= ":${LAYERDIR}"

# We have recipes-* directories, add to BBFILES
BBFILES += "${LAYERDIR}/recipes-*/*/*.bb \
            ${LAYERDIR}/recipes-*/*/*.bbappend"

BBFILE_COLLECTIONS += "meta-noassemblyrequired-net"
BBFILE_PATTERN_meta-noassemblyrequired-net = "^${LAYERDIR}/"
BBFILE_PRIORITY_meta-noassemblyrequired-net = "6"

LAYERDEPENDS_meta-noassemblyrequired-net = "core"
LAYERSERIES_COMPAT_meta-noassemblyrequired-net = "kirkstone"
```

## conf/machine/de0-nano-soc.conf
```bitbake
require conf/machine/include/socfpga.inc

KMACHINE = "de0-nano-soc"
KERNEL_IMAGETYPE = "zImage"
KERNEL_DEVICETREE = "intel/socfpga/socfpga_cyclone5_de0_nano_soc.dtb"
```

## conf/machine/include/socfpga.inc
```bitbake
SOC_FAMILY = "socfpga"

require conf/machine/include/arm/armv7a/tune-cortexa9.inc

DEFAULTTUNE = "cortexa9hf-neon"
PREFERRED_PROVIDER_virtual/kernel ?= "linux-altera-lts"
MACHINE_KERNEL_PR = "r1"
KERNEL_IMAGETYPE ?= "zImage"
MACHINE_EXTRA_RECOMMENDS =  " kernel_modules "
```
